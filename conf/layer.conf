## conf/layer.conf
```bitbake
# We have a conf and classes directory, add to BBPATH
BBPATH .= ":${LAYERDIR}"

# We have recipes-* directories, add to BBFILES
BBFILES += "${LAYERDIR}/recipes-*/*/*.bb \
            ${LAYERDIR}/recipes-*/*/*.bbappend"

BBFILE_COLLECTIONS += "imx-scfw"
BBFILE_PATTERN_imx-scfw = "^${LAYERDIR}/"
BBFILE_PRIORITY_imx-scfw = "10"

LAYERSERIES_COMPAT_imx-scfw = "langdale mickledore nanbield"
```
